
class Mario  {
public:
  unsigned int numEv = 3552;
  unsigned long evTime[3552] = {1,1,1,168,168,168,168,168,168,331,331,331,493,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190877,190877};
  unsigned char evNotes[3552] = {66,76,50,0,0,0,66,76,50,0,0,0,66,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0,0};
  unsigned char evChannels[3552] = {0,1,2,0,1,2,0,1,2,0,1,2,0,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0,1};
  int POLY = 3;
  int PIN = 26;

  unsigned long periods[128];

  void computePeriods() {
    periods[0]=0;
    for (int i=1; i<128; i++) {
      periods[i] = (unsigned long)(1000000.0/(440.0*pow(2,(i-69)/12.0)));
    }
  }

  void play() {
    const int PULSE = 30;
    unsigned long tnow = millis();
    unsigned long usnow = micros();
    unsigned long notes[POLY];
    unsigned long pulse[POLY];
    unsigned int evPtr = 0;
    for (int c=0; c<POLY; c++) {
      notes[c]=0;
    }
    while (evPtr<numEv) {
      // Wait for tone change event
      while (millis()-tnow < (unsigned long)(evTime[evPtr])) {
        // Make sound on Channels
        int val = 0;
        usnow=micros();
        for (int c=0; c<POLY; c++) {
          if (notes[c]!=0) {
            val += 60*(usnow % notes[c])/notes[c];
          }
        }
        if (val>255) {
          val=255;
        }
        dacWrite(PIN,val);
      }
      
      notes[evChannels[evPtr]] = periods[evNotes[evPtr]];
      pulse[evChannels[evPtr]] = micros();
      evPtr++;
    }
    digitalWrite(PIN, LOW);
  }

  void begin() {
    pinMode(PIN, OUTPUT);
    digitalWrite(PIN,LOW);
    computePeriods();
  }

};
  

